## config/boards/shields/kiboard/Kconfig.defconfig
```kconfig
config ZMK_BLE
	default y

config ZMK_USB
	default y

if SHIELD_KIBOARD_LEFT

config ZMK_KEYBOARD_NAME
    default "KIBOARD"

config ZMK_SPLIT_ROLE_CENTRAL
    default y

endif

if SHIELD_KIBOARD_LEFT || SHIELD_KIBOARD_RIGHT

config ZMK_SPLIT
    default y

endif
```

## config/boards/shields/kiboard/Kconfig.shield
```kconfig
config SHIELD_KIBOARD_LEFT
    def_bool $(shields_list_contains,kiboard_left)

config SHIELD_KIBOARD_RIGHT
    def_bool $(shields_list_contains,kiboard_right)
```
